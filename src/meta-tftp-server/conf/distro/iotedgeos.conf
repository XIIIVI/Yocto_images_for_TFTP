## src/meta-tftp-server/conf/distro/iotedgeos.conf
```bitbake
require conf/distro/poky-docker.conf

DISTRO = "iotedgeos"
DISTRO_NAME = "OS for Azure IoT Edge"
DISTRO_VERSION = "#-DISTRO_VERSION-#"
DISTRO_CODENAME = "spiderman"
```

## src/meta-tftp-server/conf/distro/minimalos.conf
```bitbake
require conf/distro/poky-docker.conf

DISTRO = "minimalos"
DISTRO_NAME = "Minimal OS"
DISTRO_VERSION = "#-DISTRO_VERSION-#"
DISTRO_CODENAME = "spiderman"
```

## src/meta-tftp-server/conf/distro/poky-docker.conf
```bitbake
require conf/distro/poky.conf

# Add these binaries to the HOSTTOOLS_NONFATAL variable to allow them to
# be called from within the recipe build task. They are specified as
# NONFATAL as they are not installed at the same time on the build
# system.
HOSTTOOLS_NONFATAL += "sudo pidof dockerd podman newgidmap newuidmap"

# Inherit from poky

## Mandatory features

DISTRO_FEATURES = "bash bluetooth ipv4 ipv6 systemd virtualization wifi"

## Optional features, check if needed
DISTRO_FEATURES += "ipsec"

# ALSA (sound support)

# XXX: Development only?
DISTRO_FEATURES += "usbhost"

# XXX: Development only?
DISTRO_FEATURES += "keyboard"

# Discarded features
DISTRO_FEATURES_remove = "alsa"
DISTRO_FEATURES_remove = "cramfs"
DISTRO_FEATURES_remove = "directfb"
DISTRO_FEATURES_remove = "ext2"
DISTRO_FEATURES_remove = "irda"
DISTRO_FEATURES_remove = "nfc"
DISTRO_FEATURES_remove = "opengl"
DISTRO_FEATURES_remove = "pcmcia"
DISTRO_FEATURES_remove = "ptest"
DISTRO_FEATURES_remove = "usbgadget"
DISTRO_FEATURES_remove = "wayland"
DISTRO_FEATURES_remove = "x11"

DISTRO_FEATURES += "nfs"
DISTRO_FEATURES += "smbfs"

# See https://www.yoctoproject.org/docs/3.1/ref-manual/ref-manual.html#migration-3.0-init-system-selection
# See also meta/conf/distro/include/init-manager-systemd.inc
INIT_MANAGER = "systemd"
```

## src/meta-tftp-server/conf/distro/tftpos.conf
```bitbake
require conf/distro/poky-docker.conf

DISTRO = "tftpos"
DISTRO_NAME = "OS for TFTP"
DISTRO_VERSION = "#-DISTRO_VERSION-#"
DISTRO_CODENAME = "spiderman"
```

## src/meta-tftp-server/conf/layer.conf
```bitbake
# We have a conf and classes directory, add to BBPATH
BBPATH .= ":${LAYERDIR}"

# We have recipes-* directories, add to BBFILES
BBFILES += "${LAYERDIR}/recipes-*/*/*.bb \
            ${LAYERDIR}/recipes-*/*/*.bbappend"

BBFILE_COLLECTIONS += "meta-tftp-server"
BBFILE_PATTERN_meta-tftp-server = "^${LAYERDIR}/"
BBFILE_PRIORITY_meta-tftp-server = "6"

LAYERDEPENDS_meta-tftp-server = "core"
LAYERSERIES_COMPAT_meta-tftp-server = "#-REF_SPEC-#"

# See https://www.yoctoproject.org/docs/3.1/ref-manual/ref-manual.html#var-BBFILES_DYNAMIC
BBFILES_DYNAMIC += " \
    raspberrypi:${LAYERDIR}/dynamic-layers/meta-raspberrypi/*/*/*.bbappend \
    tpm-layer:${LAYERDIR}/dynamic-layers/meta-tpm/*/*/*.bbappend \
"
```
